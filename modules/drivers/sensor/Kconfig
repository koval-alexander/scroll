## modules/drivers/sensor/custom_as5600/Kconfig
```kconfig
config CUSTOM_AS5600
    bool "Custom AS5600 Sensor Driver"
    default n
    depends on DT_HAS_ZEPHYR_CUSTOM_AS5600_ENABLED
    select I2C
    help
      Enable support for the custom AS5600 magnetic rotary position sensor.
```

## modules/dts/bindings/sensor/zephyr,custom-as5600.yaml
```yaml
description: |
    Custom AMS AS5600 Angular position sensor

compatible: "zephyr,custom-as5600"

include: [sensor-device.yaml, i2c-device.yaml]
```
